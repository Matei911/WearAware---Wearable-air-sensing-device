## sdkconfig.defaults
```kconfig
# Power management
CONFIG_PM_ENABLE=y
CONFIG_FREERTOS_USE_TICKLESS_IDLE=y
CONFIG_FREERTOS_IDLE_TIME_BEFORE_SLEEP=3

# ESP32-S3 external 32 kHz crystal
CONFIG_ESP32S3_RTC_CLK_SRC_EXT_CRYS=y
CONFIG_RTC_CLK_CAL_CYCLES=3000

# BLE / NimBLE
CONFIG_BT_ENABLED=y
CONFIG_BT_NIMBLE_ENABLED=y
CONFIG_BT_CTRL_MODEM_SLEEP=y
CONFIG_BT_CTRL_MODEM_SLEEP_MODE_1=y
CONFIG_BT_CTRL_LPCLK_SEL_MAIN_XTAL=n
CONFIG_BT_CTRL_LPCLK_SEL_EXT_32K_XTAL=y
CONFIG_BT_CTRL_MAIN_XTAL_PU_DURING_LIGHT_SLEEP=n

# BLE roles: keep only what you need
CONFIG_BT_NIMBLE_ROLE_PERIPHERAL=y
CONFIG_BT_NIMBLE_ROLE_CENTRAL=n
CONFIG_BT_NIMBLE_ROLE_OBSERVER=n
CONFIG_BT_NIMBLE_ROLE_BROADCASTER=y

# Reduce logs
CONFIG_LOG_DEFAULT_LEVEL_NONE=y
CONFIG_BOOTLOADER_LOG_LEVEL_NONE=y
CONFIG_BT_NIMBLE_LOG_LEVEL_NONE=y
CONFIG_ARDUHAL_LOG_DEFAULT_LEVEL_NONE=y

# Disable USB console/debug paths for power measurement
CONFIG_ESP_CONSOLE_NONE=y
CONFIG_ESP_CONSOLE_UART_DEFAULT=n
CONFIG_ESP_CONSOLE_UART=n
CONFIG_ESP_CONSOLE_MULTIPLE_UART=n
CONFIG_ESP_CONSOLE_SECONDARY_USB_SERIAL_JTAG=n
CONFIG_ESP_PHY_ENABLE_USB=n
CONFIG_RTC_CLOCK_BBPLL_POWER_ON_WITH_USB=n

# CPU / Arduino
CONFIG_AUTOSTART_ARDUINO=y
CONFIG_ARDUINO_LOOP_STACK_SIZE=65536
CONFIG_FREERTOS_HZ=1000


# Flash
CONFIG_ESPTOOLPY_FLASHSIZE_8MB=y
```
